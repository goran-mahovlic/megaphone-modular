// Load HAL
#include "includes.h"

#include "records.h"
#include "contacts.h"

/*
  Read the contacts and message stream generated by the stim, and put
  it all into to the D81s for the phone state.

  Linux only for testing for now.
  But it could later become part of a native backup and restore facility.
*/

void usage(void)
{
  fprintf(stderr,"usage: stim-import <stim_file.txt>\n");
  exit(-1);
}

char to_hex(unsigned char v)
{
  v&=0xf;
  if (v<0xa) return v+'0';
  if (v>0xf) return 0;
  return 'A'+(v-0xa);
}

int main(int argc,char **argv)
{
  if (argc!=2) {
    usage();
  }
  
  FILE *f=fopen(argv[1],"rb");
  
  hal_init();
  mega65_chdir("PHONE");

  char line[1024];

  // Fields for contacts
  unsigned char firstName[1024];
  unsigned char lastName[1024];
  unsigned char phoneNumber[1024];
  unsigned int unreadCount=0;
  
  // Fields for messages
  unsigned long timestampAztecTime;
  unsigned char messageBody[1024];
  
  line[0]=0; fgets(line,1024,f);
  while(line[0]) {
    // CONTACT:+99920915060:Jerry:Williams:[unread count]:
    unreadCount=0;
    if (sscanf(line,"CONTACT:%[^:]:%[^:]:%[^:]:%d",
	       phoneNumber,firstName,lastName,&unreadCount)>=3) {
      // Found a contact.
      unsigned char buffer[RECORD_DATA_SIZE];
      unsigned int bytes_used=0;
      if (build_contact(buffer,&bytes_used,
			firstName,lastName,phoneNumber,unreadCount)) {
	fprintf(stderr,"ERROR: Failed to parse contact line: %s\n",line);
      } else {	
	
	mega65_cdroot();
	mega65_chdir("PHONE");
	mount_d81("CONTACT0.D81",0);
	read_sector(0,1,0);
	unsigned int record_number = record_allocate_next( (unsigned char *)SECTOR_BUFFER_ADDRESS );
	if (!record_number) {
	  fprintf(stderr,"ERROR: Failed to allocate contact record for: %s\n",line);
	} else {
	  // Write back updated BAM
	  write_sector(0,1,0);
	  // Allocated record, so write contact
	  char r=write_contact_by_id(0,record_number,buffer);
	  if (r) {
	    fprintf(stderr,"ERROR: Failed to write contact to record #%d (code %d)\n",record_number,r);
	  }
	}
      }   
    }
    // MESSAGERX:+99973014512:397831207:🤣🎧🐨💻🥭 Id nisi MEGA65 corrupti natus:
    else if (sscanf(line,"MESSAGERX:%[^:]:%ld:%[^:]:",phoneNumber,&timestampAztecTime,messageBody)==3) {
      // 1. Work out which contact the message is to/from
      // 2. Retreive that contact (or if no such contact, then use the "UNKNOWN NUMBERS" pseudo-contact?)
      // 3. Increase unread message count by 1, and write back.
      // 4. Obtain contact physical ID from contact record, and then find and open the message D81 for that conversation.
      // 5. Allocate message record in conversation
      // 6. Build message and store.
      // 7. Update used message count in conversation (2nd half of BAM sector?)
    }
    // MESSAGETX:+99966049372:397833622:🍳🍿 Quasi nisi quidem, quis veniam sed numquam ipsam quo hic amet molestiae? Veritatis cupiditate ullam nihil et tenetur doloribus, accusantium:
    else if (sscanf(line,"MESSAGETX:%[^:]:%ld:%[^:]:",phoneNumber,&timestampAztecTime,messageBody)==3) {
      // As for MESSAGERX, but don't increment unread message count.
    } else {
      fprintf(stderr,"ERROR: Could not scan line: %s\n",line);
      exit(-1);
    }
    
    line[0]=0; fgets(line,1024,f);
  }

  // Update sorted versions of contacts
  sort_d81("CONTACT0.D81","SORT02-0.D81",0x02);	   
  sort_d81("CONTACT0.D81","SORT04-0.D81",0x04);	   
  sort_d81("CONTACT0.D81","SORT06-0.D81",0x06);	   
  
  // Update search index for contacts
  contacts_reindex(0);
}
